## main/Kconfig
```kconfig
menu "SensorSend Configuration"

config SENSOR_SEND_USER_AGENT
    string "UserAgent Name"
    default "esp-idf/1.0 esp32"
    help
      Enter the name of your UserAgent

config SENSOR_SEND_WEB_SERVER
    string "The domain name of the web server hosting the sensor data"
    default "www.server.com"
    help
      Enter the domain name of the web server hosting the sensor data

config SENSOR_SEND_WEB_SERVER_HTTPS_PORT
    string "The HTTPS port of the web server hosting the sensor data"
    default "443"
    help
      Enter the HTTPS port of the web server hosting the sensor data

config SENSOR_SEND_WEB_SERVER_HTTPS_POST_PATH
    string "The full HTTPS POST url on the web server hosting the sensor data"
    default "www.server.com/esp32/sensor.php"
    help
      Enter the full HTTPS POST url on the web server hosting the sensor data

config SENSOR_SEND_WEB_SERVER_HTTPS_POST_API_KEY
    string "The api key for the image upload"
    default ""
    help
      Enter the api key for the image upload

config SENSOR_SEND_OTA_PATH
    string "The url of the ota information file"
    default "https://server.com/ota.json"
    help
      Enter the url of the ota information file

config SENSOR_SEND_UART_NUM
    int "The number of the UART to use"
    default "1"
    help
      Enter the number of the UART to use

config SENSOR_SEND_UART_TX_PIN
    int "The UART TX pin GPIO number"
    default "17"
    help
      Enter the UART TX pin GPIO number

config SENSOR_SEND_UART_RX_PIN
    int "The UART RX pin GPIO number"
    default "18"
    help
      Enter the UART RX pin GPIO number
endmenu
```
