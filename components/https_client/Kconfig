## components/https_client/Kconfig
```kconfig
menu "HTTPS Client Configuration"

config USER_AGENT
    string "UserAgent Name"
    default "esp-idf/1.0 esp32"
    help
      Enter the name of your UserAgent

endmenu
```

## components/wifi_client/Kconfig
```kconfig
menu "WiFi Configuration"

config WIFI_SSID
    string "WiFi SSID"
    default ""
    help
      Enter the SSID of your WiFi network

config WIFI_PASSWORD
    string "WiFi Password"
    default ""
    help
      Enter the password for your WiFi network

endmenu
```
